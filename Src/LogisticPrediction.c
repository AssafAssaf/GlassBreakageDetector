/**
  ******************************************************************************
  * @file    GlassBreaking/Inc/LogisticPrediction.c 
  * @author  Assaf & Assaf
  * @version V1.0.0
  * @date    30-January-2017
  * @brief   Prediction related functions
  ******************************************************************************
**/

#include "LogisticPrediction.h"
#include "HardwareConfig.h"

extern UART_HandleTypeDef 					uartHandle;

const float theta[] = {
-0.341886923696085,
-0.107948093761955,
2.98170840728150,
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-0.0514035580516812,
};

char str2[100];

bool Predict(q15_t features[][NUM_OF_FEATURES])
{
	float 	float_features[NUM_OF_FILTERS][NUM_OF_FEATURES];
	float 	result = 0;
	int8_t 	i,j;
	
	for(i=0 ; i<NUM_OF_FILTERS ; i++)
	{
		arm_q15_to_float(features[i], float_features[i], NUM_OF_FEATURES-1);
	}
	
	// remember that the first element of X is always 1
	result = theta[0] * 1;
	
	for(i=0 ; i<NUM_OF_FILTERS ; i++){
		for (j=0 ; j<NUM_OF_FEATURES-1 ; j++){
			result += float_features[i][j] * theta[1 + i*NUM_OF_FILTERS + j];
		}
	}
	
	sprintf(str2, "X * theta = %f, ", result);
	HAL_UART_Transmit(&uartHandle, (uint8_t*)str2, strlen(str2), TIMEOUT);
	return (result >= 0);
}
